## sdkconfig.defaults
```kconfig
# Rust often needs a bit of an extra main task stack size compared to C (the default is 3K)
CONFIG_ESP_MAIN_TASK_STACK_SIZE=7000

# Use this to set FreeRTOS kernel tick frequency to 1000 Hz (100 Hz by default).
# This allows to use 1 ms granuality for thread sleeps (10 ms by default).
#CONFIG_FREERTOS_HZ=1000

# Workaround for https://github.com/espressif/esp-idf/issues/7631
#CONFIG_MBEDTLS_CERTIFICATE_BUNDLE=n
#CONFIG_MBEDTLS_CERTIFICATE_BUNDLE_DEFAULT_FULL=n

CONFIG_ESPTOOLPY_FLASHSIZE_16MB=y

CONFIG_ESP32_SPIRAM_SUPPORT=y
CONFIG_SPIRAM_MEMTEST=n

CONFIG_BOOTLOADER_SKIP_VALIDATE_ON_POWER_ON=y

CONFIG_ESP_MAIN_TASK_AFFINITY_CPU0=y

CONFIG_EPD_DISPLAY_TYPE_ED047TC1=y
CONFIG_EPD_BOARD_REVISION_LILYGO_T5_47=y
```
